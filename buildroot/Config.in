## buildroot/Config.in
```kconfig
source "$BR2_EXTERNAL_GAMEOS_PATH/package/gameos-inputd/Config.in"
source "$BR2_EXTERNAL_GAMEOS_PATH/package/gameos-sleepd/Config.in"
source "$BR2_EXTERNAL_GAMEOS_PATH/package/gameos-ui/Config.in"
source "$BR2_EXTERNAL_GAMEOS_PATH/package/gameos-retroarch/Config.in"
source "$BR2_EXTERNAL_GAMEOS_PATH/package/gameos-core-melonds/Config.in"
source "$BR2_EXTERNAL_GAMEOS_PATH/package/gameos-core-mgba/Config.in"
source "$BR2_EXTERNAL_GAMEOS_PATH/package/gameos-core-gpsp/Config.in"
source "$BR2_EXTERNAL_GAMEOS_PATH/package/gameos-core-pcsx/Config.in"
source "$BR2_EXTERNAL_GAMEOS_PATH/package/gameos-ppsspp/Config.in"
```

## buildroot/package/gameos-core-fceumm/Config.in
```kconfig
config BR2_PACKAGE_GAMEOS_CORE_FCEUMM
	bool "gameos-core-fceumm (NES)"
	depends on BR2_aarch64
	help
	  FCEUmm libretro core for NES / Famicom emulation.
	  Upstream: https://github.com/libretro/libretro-fceumm
	  License: GPL-2.0-or-later (see Copying in the source tree).
	  Mapper coverage and accuracy are the same as the widely used
	  RetroArch core; gameOS does not patch the emulator.
```

## buildroot/package/gameos-core-genesis-plus-gx/Config.in
```kconfig
config BR2_PACKAGE_GAMEOS_CORE_GENESIS_PLUS_GX
	bool "gameos-core-genesis-plus-gx (Mega Drive)"
	depends on BR2_aarch64
	help
	  Genesis Plus GX libretro core for Sega Mega Drive / Genesis,
	  Master System, Game Gear and SG-1000 emulation.
	  Upstream: https://github.com/libretro/Genesis-Plus-GX
	  License: Genesis Plus GX non-commercial license (see LICENSE.txt);
	  redistribution is permitted for non-commercial projects. gameOS
	  ships it as a separate dynamically loaded core.
```

## buildroot/package/gameos-core-gpsp/Config.in
```kconfig
config BR2_PACKAGE_GAMEOS_CORE_GPSP
	bool "gameos-core-gpsp (GBA)"
	depends on BR2_aarch64
	help
	  gpSP libretro core for Game Boy Advance emulation.
	  Built for aarch64 with the ARM64 dynamic recompiler enabled,
	  which is several times faster than interpreter-based GBA cores
	  on the same hardware. Used as the default GBA core by the
	  gameOS launcher.

	  https://github.com/libretro/gpsp
```

## buildroot/package/gameos-core-melonds/Config.in
```kconfig
config BR2_PACKAGE_GAMEOS_CORE_MELONDS
	bool "gameos-core-melonds (NDS)"
	depends on BR2_aarch64
	help
	  melonDS libretro core for Nintendo DS emulation.
	  Built with the ARM64 JIT and OpenGL renderer; WiFi disabled
	  (no libpcap dependency). Paired with the gameOS dual-screen
	  RetroArch patch for pixel-perfect output on both RG DS Plus
	  panels.

	  https://github.com/libretro/melonDS
```

## buildroot/package/gameos-core-mgba/Config.in
```kconfig
config BR2_PACKAGE_GAMEOS_CORE_MGBA
	bool "gameos-core-mgba (GBA/GBC)"
	help
	  mGBA libretro core for Game Boy Advance and Game Boy Color
	  emulation. High accuracy, low overhead — ideal for the
	  RG DS Plus Cortex-A55.

	  https://github.com/mgba-emu/mgba
```

## buildroot/package/gameos-core-pcsx/Config.in
```kconfig
config BR2_PACKAGE_GAMEOS_CORE_PCSX
	bool "gameos-core-pcsx (PS1)"
	select BR2_PACKAGE_ZLIB
	select BR2_PACKAGE_LIBPNG
	help
	  PCSX-ReARMed libretro core for PlayStation 1 emulation,
	  with the ARM64 dynamic recompiler for full-speed playback
	  on the RG DS Plus.

	  https://github.com/libretro/pcsx_rearmed
```

## buildroot/package/gameos-core-snes9x/Config.in
```kconfig
config BR2_PACKAGE_GAMEOS_CORE_SNES9X
	bool "gameos-core-snes9x (SNES)"
	depends on BR2_aarch64
	help
	  Snes9x libretro core for Super Nintendo emulation.
	  Upstream: https://github.com/libretro/snes9x
	  License: Snes9x non-commercial license (see LICENSE); redistribution
	  is permitted for non-commercial projects. gameOS ships it as a
	  separate dynamically loaded core.
```

## buildroot/package/gameos-inputd/Config.in
```kconfig
config BR2_PACKAGE_GAMEOS_INPUTD
	bool "gameos-inputd (merged gamepad daemon)"
	help
	  Merges the RG DS Plus split evdev devices (gpio-keys-control +
	  adc-joystick) into a single virtual uinput gamepad, handles
	  volume keys and lid-switch screen blanking.
```

## buildroot/package/gameos-ppsspp/Config.in
```kconfig
config BR2_PACKAGE_GAMEOS_PPSSPP
	bool "gameos-ppsspp (PSP)"
	depends on BR2_PACKAGE_MESA3D
	depends on BR2_PACKAGE_SDL2
	select BR2_PACKAGE_LIBPNG
	select BR2_PACKAGE_ZLIB
	help
	  Standalone PPSSPP (SDL2 + GLES2/EGL on KMS/DRM) for
	  PlayStation Portable emulation. Runs at 2x rendering
	  resolution on the RG DS Plus top panel.

	  https://github.com/hrydgard/ppsspp
```

## buildroot/package/gameos-retroarch/Config.in
```kconfig
config BR2_PACKAGE_GAMEOS_RETROARCH
	bool "gameos-retroarch (RetroArch with dual-screen DRM)"
	select BR2_PACKAGE_LIBDRM
	select BR2_PACKAGE_MESA3D
	select BR2_PACKAGE_MESA3D_OPENGL_EGL
	select BR2_PACKAGE_MESA3D_OPENGL_ES
	select BR2_PACKAGE_ALSA_LIB
	depends on BR2_PACKAGE_EUDEV
	select BR2_PACKAGE_ZLIB
	select BR2_PACKAGE_FREETYPE
	help
	  RetroArch v1.22.2 with the gameOS dual-screen KMS/DRM patch:
	  one 1024x1536 framebuffer spanning both RG DS Plus panels via
	  atomic modesetting, giving pixel-perfect 4x NDS dual-screen
	  output with correct touch mapping on the bottom panel.
```

## buildroot/package/gameos-sleepd/Config.in
```kconfig
config BR2_PACKAGE_GAMEOS_SLEEPD
	bool "gameos-sleepd (lid-close suspend)"
	help
	  Lid-close suspend-to-RAM daemon: pauses the emulator, runs the
	  sleep.d hooks (Wi-Fi driver out and back), suspends with a
	  deep/s2idle fallback ladder, and stays dark-and-awake while
	  charging so the charging LED survives.

	  Part of gameOS for the Anbernic RG DS Plus.
```

## buildroot/package/gameos-ui/Config.in
```kconfig
config BR2_PACKAGE_GAMEOS_UI
	bool "gameos-ui (gameOS front-end)"
	select BR2_PACKAGE_SDL2
	select BR2_PACKAGE_SDL2_KMSDRM
	select BR2_PACKAGE_SDL2_OPENGLES
	select BR2_PACKAGE_SDL2_TTF
	select BR2_PACKAGE_SDL2_IMAGE
	help
	  The gameOS front-end: a custom SDL2/KMSDRM launcher with a
	  console carousel, per-system game lists, settings and power
	  management. Chinese UI, dual-screen aware (ambient clock on
	  the bottom panel).

	  Part of gameOS for the Anbernic RG DS Plus.
```
